## conf/layer.conf
```bitbake
BBPATH .= ":${LAYERDIR}"

BBFILES += "${LAYERDIR}/recipes-*/*/*.bb \
            ${LAYERDIR}/recipes-*/*/*.bbappend"

BBFILE_COLLECTIONS += "rdk-iot"
BBFILE_PATTERN_rdk-iot = "^${LAYERDIR}/"
BBFILE_PRIORITY_rdk-iot = "5"
LAYERVERSION_rdk-iot = "1"
LAYERSERIES_COMPAT_rdk-iot = "kirkstone"
```
